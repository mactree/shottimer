/*
  simple shot timer with 7-Seg style graphic output, temprature display and
  signaloutput for a relais for baristlights during shot (version 06/06/2016)
  to use with an OLED diplay via I2C.
  by David Kißling (user mactree of http://www.kaffee-netz.de )
  BIG THANK TO:
  magicbugsbunny - for code snippets
  blu - for optimizing the code
  Torsten Wedemeyer - input and optimizing the code
  kn-forum - all the help

  changelog

v1.005.003 - change tsic libraray
   004.014 - delay check Temp 
   004.005 - delete Bounce 
   004.004 - change pin mapping 
   003.010 - change to Tsic temperature sensor
   002.030 - added "°" to the library font which makes the temperature display a lot easier
   002.026 - slow down the temperature request set resolution again to 12
   002.025 - change behaviour when sensor looses connection
   002.025 - change temp output
   002.020 - set temperature wait for conversion, slows down but stablelize the output
   002.016 - set temperature wait for conversion, slows down but stablelize the output
   002.014 - set temperature resolution 12 (max)
   002.012 - code rewrite, bugfixing
   002.011 - code rewrite
   002.010 - code rewrite
   002.008 - code rewrite, renamed variables, change behavior when P2 is connected but no PI is used
   001.030 - fix temperature output
   001.028 - change behavior of Baristalight
   001.024 - change pins for mv and pump
   001.023 - add PIN13 for baristlight and PIN10 for baristalight with pwm, added millis for better dimming
   001.011 - code rewrite, post infusion in upper reight corner
   001.001 - code rewrite
   000.010 - change relais pin to 10 for pwm, add postinfusion,
       009 - change behavior of signalinput P1 ist starting the timer and P2 is switchich the PI
       008 - bugfix: degree when temperature sinks under 100°
       004 - change temprature display
       003 - release

*/

// librarys
#include <MsTimer2.h>
#include <Arduino.h>
#include <Wire.h>
#include <MicroLCD.h>
#include "TSIC.h"

// comment in for use with relais
//#include <Bounce.h>



// 7-segemnt graphic
const PROGMEM uint8_t zero[256] = {
  0x00, 0x00, 0x00, 0xC8, 0xDC, 0xDE, 0x9E, 0xBE, 0x3E, 0x3E, 0x3E, 0x3E,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 0x00,
};

const PROGMEM uint8_t one[256] = {
  0x00, 0x00, 0x00, 0x00, 0x00, 0x00, 0x00, 0x00, 0x00, 0x00, 0x00, 0x00,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 0x00,
};

const PROGMEM uint8_t two[256] = {
  0x00, 0x00, 0x00, 0x08, 0x1C, 0x1E, 0x1E, 0x3E, 0x3E, 0x3E, 0x3E, 0x3E,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 0x00,
};

const PROGMEM uint8_t three[256] = {
  0x00, 0x00, 0x00, 0x00, 0x1C, 0x1E, 0x1E, 0x3E, 0x3E, 0x3E, 0x3E, 0x3E,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 0x00,
};

const PROGMEM uint8_t four[256] = {
  0x00, 0x00, 0x00, 0xF0, 0xF0, 0xF0, 0xE0, 0xE0, 0x00, 0x00, 0x00, 0x00,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 0x00,
};

const PROGMEM uint8_t five[256] = {
  0x00, 0x00, 0x00, 0xC8, 0xDC, 0xDE, 0x9E, 0xBE, 0x3E, 0x3E, 0x3E, 0x3E,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 0x00,
};

const PROGMEM uint8_t six[256] = {
  0x00, 0x00, 0x00, 0xC8, 0xDC, 0xDE, 0x9E, 0xBE, 0x3E, 0x3E, 0x3E, 0x3E,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 0x00,
};

const PROGMEM uint8_t seven[256] = {
  0x00, 0x00, 0x00, 0xC8, 0xDC, 0xDE, 0x9E, 0xBE, 0x3E, 0x3E, 0x3E, 0x3E,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 0x00,
};

const PROGMEM uint8_t eight[256] = {
  0x00, 0x00, 0x00, 0xC8, 0xDC, 0xDE, 0x9E, 0xBE, 0x3E, 0x3E, 0x3E, 0x3E,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 0x00,
};

const PROGMEM uint8_t nine[256] = {
  0x00, 0x00, 0x00, 0xC8, 0xDC, 0xDE, 0x9E, 0xBE, 0x3E, 0x3E, 0x3E, 0x3E,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 0x00,
};

// setup for the tsic sensor on pin 2
//TSIC Sensor1(2, 3); // Signalpin, VCCpin,
TSIC Sensor1(2);    // only Signalpin, VCCpin unused by default
TSIC Sensor2(3);    // only Signalpin, VCCpin unused by default


//OLED on I2C-bus
LCD_SSD1306 lcd;

// define signal input
const int btnPUMPpin = 7;
const int btnSTARTpin = 5;

// define pin => connect to IRLIZ44N (GATE) with PWM
int baristaLightPWM = 6;


// define how long the last shot-time will be shown
int showLastShot = 1000; // 500 => 5s; 1000 => 10s

// define global variables
int count = 0;
int tcount = 0;
bool timerRUN = 0;
bool sleeptimerRUN = 0;
bool sleep = 1;
bool hold = 1;
char* version[] = {"Espresso", "Shot Timer", "v1.006.045"};
long previous;
long onTIME;


bool getSecondTime = 0;
bool getFirstTime = 0;
bool getThirdTime = 0;

bool lcdclear = 0;

float TIME;
int firstTIME;
int secondTIME;


// sensors
int checkTemp = 0;
bool checkTemp2 = 0;

// sensor 1
float TEMP = 0;
uint16_t temperature = 0;
//uint16_t tmp = 0;
uint16_t previousTMP = 0;

const int numReadings = 10;

int readings[numReadings];      // the readings from the analog input
int readings2[numReadings];      // the readings from the analog input
int readIndex = 0;              // the index of the current reading
int readIndex2 = 0;    
int total = 0;                  // the running total
int total2 = 0; 
int error = 0;
int error2 = 0;



float TEMP2 = 0;
uint16_t temperature2 = 0;
// uint16_t tmp2 = 0;
uint16_t previousTMP2 = 0;


bool requestT;
bool prepareTemp = true;


// light
bool turnLightOn = 0;
bool LightIsOn = 0;
bool turnLightOff = 0;
bool LightIsOff = 0;
int dimm = 0;
int brightness = 200; // 255 => max 127 => 50%
unsigned long turnOffDelay;

// display
bool StartScreen = 1;


void setup() {
    //Serial.begin(9600);
  
  pinMode(btnSTARTpin, INPUT);
  digitalWrite(btnSTARTpin, HIGH);
  pinMode(btnPUMPpin, INPUT);
  digitalWrite(btnPUMPpin, HIGH);
  pinMode(baristaLightPWM, OUTPUT);
  digitalWrite(baristaLightPWM, LOW);
  delay(40);
  lcd.begin();

    lcd.setFontSize(FONT_SIZE_MEDIUM);
    lcd.setCursor(5, 0);
    lcd.print(version[0]);
    lcd.setCursor(5, 3);
    lcd.print(version[1]);
    lcd.setFontSize(FONT_SIZE_SMALL);
    lcd.setCursor(60, 7);
    lcd.print(version[2]);
    
      
    delay(3000);

  //check if temperature sensor tsic is connected runs only once
 
    Sensor1.getTemperature(&temperature);
              Serial.println(temperature);
    TEMP = Sensor1.calc_Celsius(&temperature);  
          Serial.println(TEMP);
    Sensor2.getTemperature(&temperature2);
          Serial.println(temperature2);
    TEMP2 = Sensor2.calc_Celsius(&temperature2);  
          Serial.println(TEMP2);          
    if (TEMP > 0) {
      checkTemp = checkTemp + 1;
    }
    if (TEMP2 > 0){
      checkTemp = checkTemp + 2;
    }
     for (int thisReading = 0; thisReading < numReadings; thisReading++) {
    readings[thisReading] = 0;
  }

     for (int thisReading = 0; thisReading < numReadings; thisReading++) {
    readings2[thisReading] = 0;
  }

}

void loop() {

  //check for signal
  int klick1 = !digitalRead(btnSTARTpin);
  int klick2 = !digitalRead(btnPUMPpin);


  // active signal on P1 start timer
  if (klick1) {
    if (!timerRUN) {
      MsTimer2::set(10, zeitLaeuft);
      MsTimer2::start();
      // reset lcd
      lcd.clear();
      // set variable
      timerRUN = 1;
      count = 0;
      TIME = 0;
      firstTIME = 0;
      secondTIME = 0;
      sleep = 0;
      sleeptimerRUN = 0;
      hold = 1;
      turnLightOn = 1;
      StartScreen = 0;
    }
  }

  // timer is running
  if (timerRUN && klick1) {
    float countF = count;
    int TIME = countF / 100;
    // get first time
    if (!getFirstTime) {
      getFirstTime = 1;
    }
    // get second time
    if (klick1 && klick2 && !getSecondTime) {
      firstTIME = TIME;
      getSecondTime = 1;
      count = 0;
    }
    // get third time
    if (getFirstTime && getSecondTime && !getThirdTime && !klick2) {
      secondTIME = TIME;
      TIME = 0;
      count = 0;
      getThirdTime = 1;
    }
    // seven segment
    if (!getThirdTime) {
      lcd.setCursor(66, 2);
      paint(TIME % 10);
      lcd.setCursor(30, 2);
      paint((TIME / 10) % 10);
    }
    lcd.setFontSize(FONT_SIZE_MEDIUM);
    if (firstTIME != 0 && getSecondTime) {
      lcd.setCursor(5, 0);
      lcd.print("PI: ");
      lcd.println(firstTIME);
    }
    if (TIME > 0 && getThirdTime ) {
      lcd.setCursor(70, 0);
      lcd.print("PI: ");
      lcd.println(TIME);
    }
  }
  // no active signal
  if (timerRUN && !klick1) {
    MsTimer2::stop();
    float countF = count;
    TIME = countF / 100;
    timerRUN = 0;
    sleep = 1;
    count = 0;
    //      tcount = 0;
    getFirstTime = 0;
    getSecondTime = 0;
    getThirdTime = 0;
  }
  if (sleep) {
    if (!sleeptimerRUN) {
      MsTimer2::set(10, zeitLaeuft);
      MsTimer2::start();
      sleeptimerRUN = 1;
    }
  }
  if (sleep && sleeptimerRUN) {
    if ((count > showLastShot) || ((TIME + firstTIME + secondTIME) < 8)) {
      MsTimer2::stop();
      lcd.clear();
      sleeptimerRUN = 0;
      count = 0;
      sleep = 0;
      hold = 0;
      turnLightOff = 1;
      getFirstTime = 0;
      getSecondTime = 0;
      getThirdTime = 0;
      requestT = 1;
    }
  }
  // get and display temperature runs only if tsic is present on startup
  if (checkTemp && !timerRUN && !klick1 && !hold) {
    if ( requestT) {
      requestT = 0;
    }
    if (!requestT && tcount >= 20000) {
      requestT = 1;
      tcount = 0;
 
      
            



      

      if(checkTemp ==3){
        getTemp();
        getTemp2();
        lcd.setFontSize(FONT_SIZE_MEDIUM);
        lcd.setCursor(5, 2);
        lcd.print("Gruppe: ");
        lcd.print(TEMP, 1);
        // uses modified font "^" is replaced by "°"
        lcd.print("^  ");
        lcd.setCursor(5, 5);
        lcd.print("Kessel: ");  
        lcd.print(TEMP2, 1);
        lcd.print("^  ");  
      }
      else if( checkTemp == 2){
        getTemp2();
        lcd.setFontSize(FONT_SIZE_MEDIUM);
        lcd.setCursor(5, 3);
        lcd.print("Kessel: ");  
        lcd.print(TEMP2, 1);
        lcd.print("^  ");   
      }
      else{
        getTemp();
        lcd.setFontSize(FONT_SIZE_MEDIUM);
        lcd.setCursor(5, 3);
        lcd.print("Gruppe: ");
        lcd.print(TEMP, 1);
        lcd.print("^  ");
      }



      
      Serial.print(" TEMP1: ");
      Serial.print(TEMP);
      Serial.print(" raw1: ");
      Serial.print(temperature);
      Serial.print("-");
//      Serial.print(tmp);
      Serial.print("-");
      Serial.print(previousTMP);      
      Serial.print("  TEMP2: ");
      Serial.print(TEMP2);   
      Serial.print(" raw2: ");
      Serial.print(temperature2);
      Serial.print("-");
    Serial.print(previousTMP2); 
      Serial.print("-");
      Serial.print(error2);
      Serial.print("-");
      Serial.println(checkTemp);
    }                   

    tcount++;
  }
  if (turnLightOn && !LightIsOn) {
    // turn BaristaLight on
    LightIsOn = 1;
    LightIsOff = 0;
    turnLightOff = 0;
    if (dimm < 100) {
      dimm = 100;
    }
    turnOffDelay = 0;
  }
  if (LightIsOn) {
    if ( dimm < brightness) {
      unsigned long current = millis();
      if (current - previous > 10) {
        previous = current;
        dimm = dimm + 5;
      }
    }
    analogWrite(baristaLightPWM, dimm);
  }
  if (turnLightOff && !LightIsOff && dimm == brightness) {
    // turn BaristaLight off
    turnLightOn = 0;
    LightIsOn = 0;
    LightIsOff = 1;
    turnOffDelay = millis();
  }
  if (LightIsOff) {
    unsigned long current = millis();

    if (current - turnOffDelay > 90000) {
      if (dimm > 0 ) {
        //unsigned long current = millis();
        if (current - previous > 10) {
          previous = current;
          dimm = dimm - 5;
        }
      }
      if (dimm < 10) {
        hold = 0;
      }
      analogWrite(baristaLightPWM, dimm);
    }
  }
}

void paint(int ziffer) {
  switch (ziffer)
  {
    case 0:    // 0
      lcd.draw(zero, 32, 48);
      break;
    case 1:    // 1
      lcd.draw(one, 32, 48);
      break;
    case 2:    // 2
      lcd.draw(two, 32, 48);
      break;
    case 3:    // 3
      lcd.draw(three, 32, 48);
      break;
    case 4:    // 4
      lcd.draw(four, 32, 48);
      break;
    case 5:    // 5
      lcd.draw(five, 32, 48);
      break;
    case 6:    // 6
      lcd.draw(six, 32, 48);
      break;
    case 7:    // 7
      lcd.draw(seven, 32, 48);
      break;
    case 8:    // 8
      lcd.draw(eight, 32, 48);
      break;
    case 9:    // 9
      lcd.draw(nine, 32, 48);
      break;
  }
}
void zeitLaeuft() {
  count++;
}
